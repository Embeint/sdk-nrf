## west.yml
```yaml
manifest:
  remotes:
    # nRF Connect SDK GitHub organization.
    # NCS repositories are hosted here.
    - name: ncs
      url-base: https://github.com/nrfconnect

  projects:
    - name: nrfxlib
      remote: ncs
      repo-path: sdk-nrfxlib
      path: modules/nrfconnect/nrfxlib
      revision: 7bb7bea347d8161cdb485f5e0517ff4f5cc3025b
    - name: oberon-psa-crypto
      remote: ncs
      path: modules/crypto/oberon-psa-crypto
      repo-path: sdk-oberon-psa-crypto
      revision: e8db62ed0fba5028e7ae0eba7b1fb63436ae6416
    - name: ncs-edge-ai
      remote: ncs
      repo-path: sdk-edge-ai
      path: modules/nrfconnect/sdk-edge-ai
      revision: v2.1.0
```
