## Kconfig.nrf
```kconfig
#
# Copyright (c) 2018-2023 Nordic Semiconductor
#
# SPDX-License-Identifier: LicenseRef-Nordic-5-Clause
#

menu "Nordic nRF Connect"

rsource "drivers/Kconfig"
rsource "lib/Kconfig"
rsource "modules/Kconfig"
rsource "subsys/Kconfig"

config NRFX_RESERVED_RESOURCES_HEADER
	string
	default "nrfx_config_reserved_resources_ncs.h"

endmenu
```

## drivers/Kconfig
```kconfig
#
# Copyright (c) 2018-2020 Nordic Semiconductor ASA
#
# SPDX-License-Identifier: LicenseRef-Nordic-5-Clause
#

menu "Device Drivers"

rsource "entropy/Kconfig"
rsource "hw_cc3xx/Kconfig"
rsource "wifi/Kconfig"

endmenu
```

## drivers/cracen/Kconfig
```kconfig
# CRACEN drivers

config CRACEN_LIB_KMU
	bool "CRACEN KMU library"
	depends on SOC_SERIES_NRF54LX
	select NRFX_RRAMC if !BUILD_WITH_TFM
	default y
	help
	  The CRACEN KMU library.
```

## lib/Kconfig
```kconfig
#
# Copyright (c) 2018 Nordic Semiconductor ASA
#
# SPDX-License-Identifier: LicenseRef-Nordic-5-Clause
#

menu "Libraries"

rsource "at_cmd_parser/Kconfig"
rsource "at_host/Kconfig"
rsource "at_monitor/Kconfig"
rsource "lte_link_control/Kconfig"
rsource "multithreading_lock/Kconfig"
rsource "nrf_modem_lib/Kconfig"
rsource "pdn/Kconfig"

endmenu
```

## lib/modem_antenna/Kconfig
```kconfig
#
# Copyright (c) 2022 Nordic Semiconductor ASA
#
# SPDX-License-Identifier: LicenseRef-Nordic-5-Clause
#

menuconfig MODEM_ANTENNA
	bool "Modem antenna configuration"
	depends on NRF_MODEM_LIB

if MODEM_ANTENNA

choice
	default MODEM_ANTENNA_GNSS_ONBOARD
	prompt "Select which antenna to use for GNSS"

config MODEM_ANTENNA_GNSS_ONBOARD
	bool "Use onboard antenna"

config MODEM_ANTENNA_GNSS_EXTERNAL
	bool "Use external antenna"

endchoice

config MODEM_ANTENNA_AT_MAGPIO
	string "AT%XMAGPIO command"
	help
	  Defines the AT%XMAGPIO command to be sent to the modem. Leave
	  empty if this command should not be sent.

config MODEM_ANTENNA_AT_COEX0
	string "AT%XCOEX0 command"
	default "AT\%XCOEX0=1,1,1565,1586" if MODEM_ANTENNA_GNSS_ONBOARD
	default "AT\%XCOEX0" if MODEM_ANTENNA_GNSS_EXTERNAL
	help
	  Defines the AT%XCOEX0 command to be sent to the modem. Leave
	  empty if this command should not be sent.

config MODEM_ANTENNA_AT_MIPIRFFEDEV
	string "AT%XMIPIRFFEDEV command"
	help
	  Defines the AT%XMIPIRFFEDEV command to be sent to the modem. Leave
	  empty if this command should not be sent.

config MODEM_ANTENNA_AT_MIPIRFFECTRL_INIT
	string "AT%XMIPIRFFECTRL command (INIT)"
	help
	  Defines the AT%XMIPIRFFECTRL command to be sent to the modem for INIT phase.
	  Leave empty if this command should not be sent.

config MODEM_ANTENNA_AT_MIPIRFFECTRL_ON
	string "AT%XMIPIRFFECTRL command (ON)"
	help
	  Defines the AT%XMIPIRFFECTRL command to be sent to the modem for ON phase.
	  Leave empty if this command should not be sent.

config MODEM_ANTENNA_AT_MIPIRFFECTRL_OFF
	string "AT%XMIPIRFFECTRL command (OFF)"
	help
	  Defines the AT%XMIPIRFFECTRL command to be sent to the modem for OFF phase.
	  Leave empty if this command should not be sent.

config MODEM_ANTENNA_AT_MIPIRFFECTRL_PWROFF
	string "AT%XMIPIRFFECTRL command (PWROFF)"
	help
	  Defines the AT%XMIPIRFFECTRL command to be sent to the modem for PWROFF phase.
	  Leave empty if this command should not be sent.

module=MODEM_ANTENNA
module-dep=LOG
module-str=Modem antenna
source "${ZEPHYR_BASE}/subsys/logging/Kconfig.template.log_config"

endif # MODEM_ANTENNA
```

## samples/bluetooth/direct_test_mode/sample.yaml
```yaml
sample:
  description: Bluetooth Low Energy Direct Test Mode sample
  name: Bluetooth LE Direct Test Mode
common:
  tags:
    - bluetooth
    - ci_build
    - sysbuild
    - ci_samples_bluetooth
tests:
  sample.bluetooth.direct_test_mode:
    sysbuild: true
    build_only: true
    integration_platforms:
      - nrf52840dk/nrf52840
      - nrf54l15dk/nrf54l15/cpuapp
    platform_allow:
      - nrf52840dk/nrf52840
      - nrf54l15dk/nrf54l05/cpuapp
      - nrf54l15dk/nrf54l10/cpuapp
      - nrf54l15dk/nrf54l15/cpuapp
      - nrf54lm20dk/nrf54lm20b/cpuapp
```
